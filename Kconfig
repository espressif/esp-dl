## Kconfig
```kconfig
choice CONV_IMPL
    bool "Convolution Implementation"
    default XTENSA_IMPL
      
config C_IMPL
	bool "ANSI Implementation for general platforms"

config XTENSA_IMPL
	bool "Xtensa Implementation for ESP"
	
endchoice



menu "ESP-FACE Configuration"

    choice DETECTION_MODEL
        bool "Detection Model"
        default MTMN_LITE_QUANT

        config MTMN_LITE_QUANT
            bool "MTMN lite in quantization"
        
        config MTMN_LITE_FLOAT
            bool "MTMN lite in float"
    endchoice
    
endmenu
```

## esp-dl/Kconfig
```kconfig
menu "ESP-DL Configuration"
    menu "Vision/Image: Pixel Convert Support"
        config PIX_CVT_RGB565_TO_RGB565_SUPPORT
            bool "Support conversions from rgb565 to rgb565."
            default y
        config PIX_CVT_RGB565_TO_RGB888_SUPPORT
            bool "Support conversions from rgb565 to rgb888."
            default y
        config PIX_CVT_RGB565_TO_GRAY_SUPPORT
            bool "Support conversions from rgb565 to gray."
            default y
        config PIX_CVT_RGB565_TO_HSV_SUPPORT
            bool "Support conversions from rgb565 to hsv."
            default y
        config PIX_CVT_RGB888_TO_RGB888_SUPPORT
            bool "Support conversions from rgb888 to rgb888."
            default y
        config PIX_CVT_RGB888_TO_RGB565_SUPPORT
            bool "Support conversions from rgb888 to rgb565."
            default y
        config PIX_CVT_RGB888_TO_GRAY_SUPPORT
            bool "Support conversions from rgb888 to gray."
            default y
        config PIX_CVT_RGB888_TO_HSV_SUPPORT
            bool "Support conversions from rgb888 to hsv."
            default y
        config PIX_CVT_GRAY_TO_GRAY_SUPPORT
            bool "Support conversions from gray to gray."
            default y
        config PIX_CVT_HSV_TO_HSV_MASK_SUPPORT
            bool "Support conversions from hsv to hsv_mask."
            default y
        config PIX_CVT_YUV_TO_RGB888_SUPPORT
            bool "Support conversions from yuv to rgb888."
            default y
        config PIX_CVT_YUV_TO_RGB565_SUPPORT
            bool "Support conversions from yuv to rgb565."
            default y
        config PIX_CVT_YUV_TO_GRAY_SUPPORT
            bool "Support conversions from yuv to gray."
            default y
        config PIX_CVT_YUV_TO_HSV_SUPPORT
            bool "Support conversions from yuv to hsv."
            default y
        config PIX_CVT_YUV_TO_YUV_SUPPORT
            bool "Support conversions from yuv to yuv."
            default y
    endmenu
endmenu
```

## examples/pedestrian_detect/components/esp_jpeg/Kconfig
```kconfig
menu "JPEG Decoder"

    config JD_USE_ROM
        bool "Use TinyJPG Decoder from ROM"
        depends on IDF_TARGET_ESP32 || IDF_TARGET_ESP32C3 || IDF_TARGET_ESP32C6 || IDF_TARGET_ESP32S3
        default y
        help
            By default, Espressif SoCs use TJpg decoder implemented in ROM code.
            If this feature is disabled, new configuration of TJpg decoder can be used.
            Refer to REAME.md for more details.

    config JD_SZBUF
        int "Size of stream input buffer"
        depends on !JD_USE_ROM
        default 512

    config JD_FORMAT
        int
        depends on !JD_USE_ROM
        default 0 if JD_FORMAT_RGB888
        default 1 if JD_FORMAT_RGB565

        choice
            prompt "Output pixel format"
            depends on !JD_USE_ROM
            default JD_FORMAT_RGB888
            help
                Output format is selected at runtime.

        config JD_FORMAT_RGB888
            bool "Support RGB565 and RGB888 output (16-bit/pix and 24-bit/pix)"
        config JD_FORMAT_RGB565
            bool "Support RGB565 output (16-bit/pix)"
        endchoice

    config JD_USE_SCALE
        bool "Enable descaling"
        depends on !JD_USE_ROM
        default y
        help
            If scaling is enabled, size of output image can be lowered during decoding.

    config JD_TBLCLIP
        bool "Use table conversion for saturation arithmetic"
        depends on !JD_USE_ROM
        default y
        help
            Use table conversion for saturation arithmetic. A bit faster, but increases 1 KB of code size.

    config JD_FASTDECODE
        int
        depends on !JD_USE_ROM
        default 0 if JD_FASTDECODE_BASIC
        default 1 if JD_FASTDECODE_32BIT
        default 2 if JD_FASTDECODE_TABLE

        choice
            prompt "Optimization level"
            depends on !JD_USE_ROM
            default JD_FASTDECODE_32BIT

        config JD_FASTDECODE_BASIC
            bool "Basic optimization. Suitable for 8/16-bit MCUs"
        config JD_FASTDECODE_32BIT
            bool "+ 32-bit barrel shifter. Suitable for 32-bit MCUs"
        config JD_FASTDECODE_TABLE
            bool "+ Table conversion for huffman decoding (wants 6 << HUFF_BIT bytes of RAM)"
        endchoice
endmenu
```

## examples/person_reid/components/spiflash_fatfs/Kconfig
```kconfig
menu "models: person_reid"
    config SPIFLASH_MOUNT_POINT
        string "spiflash fatfs mount point"
        default "/spiflash"

    config SPIFLASH_MOUNT_PARTITION
        string "spiflash fatfs mount partition"
        default "storage"
endmenu
```

## face_recognition/Kconfig
```kconfig
choice CONV_IMPL
    bool "Convolution Implementation"
    default XTENSA_IMPL
      
config C_IMPL
	bool "ANSI Implementation for general platforms"

config XTENSA_IMPL
	bool "Xtensa Implementation for ESP"
	
endchoice
```

## models/cat_detect/Kconfig
```kconfig
menu "models: cat_detect"
    config FLASH_ESPDET_PICO_224_224_CAT
        bool "flash espdet_pico_224_224_cat"
        depends on !CAT_DETECT_MODEL_IN_SDCARD
        default y
    config FLASH_ESPDET_PICO_416_416_CAT
        bool "flash espdet_pico_416_416_cat"
        depends on !CAT_DETECT_MODEL_IN_SDCARD
        default n

    choice
        prompt "default model"
        default ESPDET_PICO_224_224_CAT
        help
            default cat_detect model
        config ESPDET_PICO_224_224_CAT
            bool "espdet_pico_224_224_cat"
            depends on CAT_DETECT_MODEL_IN_SDCARD || FLASH_ESPDET_PICO_224_224_CAT
        config ESPDET_PICO_416_416_CAT
            bool "espdet_pico_416_416_cat"
            depends on CAT_DETECT_MODEL_IN_SDCARD || FLASH_ESPDET_PICO_416_416_CAT
    endchoice

    config DEFAULT_CAT_DETECT_MODEL
        int
        default 0 if ESPDET_PICO_224_224_CAT
        default 1 if ESPDET_PICO_416_416_CAT

    choice
        prompt "model location"
        default CAT_DETECT_MODEL_IN_FLASH_RODATA
        help
            cat_detect model location
        config CAT_DETECT_MODEL_IN_FLASH_RODATA
            bool "flash_rodata"
        config CAT_DETECT_MODEL_IN_FLASH_PARTITION
            bool "flash_partition"
        config CAT_DETECT_MODEL_IN_SDCARD
            bool "sdcard"
    endchoice

    config CAT_DETECT_MODEL_LOCATION
        int
        default 0 if CAT_DETECT_MODEL_IN_FLASH_RODATA
        default 1 if CAT_DETECT_MODEL_IN_FLASH_PARTITION
        default 2 if CAT_DETECT_MODEL_IN_SDCARD

    config CAT_DETECT_MODEL_SDCARD_DIR
        string "cat_detect model sdcard dir"
        default "models/s3" if IDF_TARGET_ESP32S3
        default "models/p4" if IDF_TARGET_ESP32P4
        depends on CAT_DETECT_MODEL_IN_SDCARD
        help
            Directory of models relative to sdcard mount point.
endmenu
```

## models/coco_detect/Kconfig
```kconfig
menu "models: coco_detect"
    config FLASH_COCO_DETECT_YOLO11N_S8_V1
        bool "flash coco_detect_yolo11n_s8_v1"
        depends on !COCO_DETECT_MODEL_IN_SDCARD
        default n
    config FLASH_COCO_DETECT_YOLO11N_S8_V2
        bool "flash coco_detect_yolo11n_s8_v2"
        depends on !COCO_DETECT_MODEL_IN_SDCARD
        default n
    config FLASH_COCO_DETECT_YOLO11N_S8_V3
        bool "flash coco_detect_yolo11n_s8_v3"
        depends on !COCO_DETECT_MODEL_IN_SDCARD
        default y
    config FLASH_COCO_DETECT_YOLO11N_320_S8_V3
        bool "flash coco_detect_yolo11n_320_s8_v3"
        depends on !COCO_DETECT_MODEL_IN_SDCARD
        default n

    choice
        prompt "default model"
        default COCO_DETECT_YOLO11N_S8_V3
        help
            default coco_detect model
        config COCO_DETECT_YOLO11N_S8_V1
            bool "coco_detect_yolo11n_s8_v1"
            depends on COCO_DETECT_MODEL_IN_SDCARD || FLASH_COCO_DETECT_YOLO11N_S8_V1
        config COCO_DETECT_YOLO11N_S8_V2
            bool "coco_detect_yolo11n_s8_v2"
            depends on COCO_DETECT_MODEL_IN_SDCARD || FLASH_COCO_DETECT_YOLO11N_S8_V2
        config COCO_DETECT_YOLO11N_S8_V3
            bool "coco_detect_yolo11n_s8_v3"
            depends on COCO_DETECT_MODEL_IN_SDCARD || FLASH_COCO_DETECT_YOLO11N_S8_V3
        config COCO_DETECT_YOLO11N_320_S8_V3
            bool "coco_detect_yolo11n_320_s8_v3"
            depends on COCO_DETECT_MODEL_IN_SDCARD || FLASH_COCO_DETECT_YOLO11N_320_S8_V3
    endchoice

    config DEFAULT_COCO_DETECT_MODEL
        int
        default 0 if COCO_DETECT_YOLO11N_S8_V1
        default 1 if COCO_DETECT_YOLO11N_S8_V2
        default 2 if COCO_DETECT_YOLO11N_S8_V3
        default 3 if COCO_DETECT_YOLO11N_320_S8_V3

    choice
        prompt "model location"
        default COCO_DETECT_MODEL_IN_FLASH_RODATA
        help
            coco_detect model location
        config COCO_DETECT_MODEL_IN_FLASH_RODATA
            bool "flash_rodata"
        config COCO_DETECT_MODEL_IN_FLASH_PARTITION
            bool "flash_partition"
        config COCO_DETECT_MODEL_IN_SDCARD
            bool "sdcard"
    endchoice

    config COCO_DETECT_MODEL_LOCATION
        int
        default 0 if COCO_DETECT_MODEL_IN_FLASH_RODATA
        default 1 if COCO_DETECT_MODEL_IN_FLASH_PARTITION
        default 2 if COCO_DETECT_MODEL_IN_SDCARD

    config COCO_DETECT_MODEL_SDCARD_DIR
        string "coco_detect model sdcard dir"
        default "models/s3" if IDF_TARGET_ESP32S3
        default "models/p4" if IDF_TARGET_ESP32P4
        depends on COCO_DETECT_MODEL_IN_SDCARD
        help
            Directory of models relative to sdcard mount point.
endmenu
```

## models/coco_pose/Kconfig
```kconfig
menu "models: coco_pose"
    config FLASH_COCO_POSE_YOLO11N_POSE_S8_V1
        bool "flash coco_pose_yolo11n_pose_s8_v1"
        depends on !COCO_POSE_MODEL_IN_SDCARD
        default n
    config FLASH_COCO_POSE_YOLO11N_POSE_S8_V2
        bool "flash coco_pose_yolo11n_pose_s8_v2"
        depends on !COCO_POSE_MODEL_IN_SDCARD
        default y

    choice
        prompt "default model"
        default COCO_POSE_YOLO11N_POSE_S8_V2
        help
            default coco_pose model
        config COCO_POSE_YOLO11N_POSE_S8_V1
            bool "coco_pose_yolo11n_pose_s8_v1"
            depends on COCO_POSE_MODEL_IN_SDCARD || FLASH_COCO_POSE_YOLO11N_POSE_S8_V1
        config COCO_POSE_YOLO11N_POSE_S8_V2
            bool "coco_pose_yolo11n_pose_s8_v2"
            depends on COCO_POSE_MODEL_IN_SDCARD || FLASH_COCO_POSE_YOLO11N_POSE_S8_V2
    endchoice

    config DEFAULT_COCO_POSE_MODEL
        int
        default 0 if COCO_POSE_YOLO11N_POSE_S8_V1
        default 1 if COCO_POSE_YOLO11N_POSE_S8_V2


    choice
        prompt "model location"
        default COCO_POSE_MODEL_IN_FLASH_RODATA
        help
            coco_pose model location
        config COCO_POSE_MODEL_IN_FLASH_RODATA
            bool "flash_rodata"
        config COCO_POSE_MODEL_IN_FLASH_PARTITION
            bool "flash_partition"
        config COCO_POSE_MODEL_IN_SDCARD
            bool "sdcard"
    endchoice

    config COCO_POSE_MODEL_LOCATION
        int
        default 0 if COCO_POSE_MODEL_IN_FLASH_RODATA
        default 1 if COCO_POSE_MODEL_IN_FLASH_PARTITION
        default 2 if COCO_POSE_MODEL_IN_SDCARD

    config COCO_POSE_MODEL_SDCARD_DIR
        string "coco_pose model sdcard dir"
        default "models/s3" if IDF_TARGET_ESP32S3
        default "models/p4" if IDF_TARGET_ESP32P4
        depends on COCO_POSE_MODEL_IN_SDCARD
        help
            Directory of models relative to sdcard mount point.
endmenu
```

## models/coco_seg/Kconfig
```kconfig
menu "models: coco_seg"
    config FLASH_COCO_SEG_YOLO11N_SEG_S8_V1
        bool "flash coco_seg_yolo11n_seg_s8_v1"
        depends on !COCO_SEG_MODEL_IN_SDCARD
        default y

    choice
        prompt "default model"
        default COCO_SEG_YOLO11N_SEG_S8_V1
        help
            default coco_seg model
        config COCO_SEG_YOLO11N_SEG_S8_V1
            bool "coco_seg_yolo11n_seg_s8_v1"
            depends on COCO_SEG_MODEL_IN_SDCARD || FLASH_COCO_SEG_YOLO11N_SEG_S8_V1
    endchoice

    config DEFAULT_COCO_SEG_MODEL
        int
        default 0 if COCO_SEG_YOLO11N_SEG_S8_V1


    choice
        prompt "model location"
        default COCO_SEG_MODEL_IN_FLASH_RODATA
        help
            coco_seg model location
        config COCO_SEG_MODEL_IN_FLASH_RODATA
            bool "flash_rodata"
        config COCO_SEG_MODEL_IN_FLASH_PARTITION
            bool "flash_partition"
        config COCO_SEG_MODEL_IN_SDCARD
            bool "sdcard"
    endchoice

    config COCO_SEG_MODEL_LOCATION
        int
        default 0 if COCO_SEG_MODEL_IN_FLASH_RODATA
        default 1 if COCO_SEG_MODEL_IN_FLASH_PARTITION
        default 2 if COCO_SEG_MODEL_IN_SDCARD

    config COCO_SEG_MODEL_SDCARD_DIR
        string "coco_seg model sdcard dir"
        default "models/s3" if IDF_TARGET_ESP32S3
        default "models/p4" if IDF_TARGET_ESP32P4
        depends on COCO_SEG_MODEL_IN_SDCARD
        help
            Directory of models relative to sdcard mount point.
endmenu
```

## models/dog_detect/Kconfig
```kconfig
menu "models: dog_detect"
    config FLASH_ESPDET_PICO_224_224_DOG
        bool "flash espdet_pico_224_224_dog"
        depends on !DOG_DETECT_MODEL_IN_SDCARD
        default y
    config FLASH_ESPDET_PICO_416_416_DOG
        bool "flash espdet_pico_416_416_dog"
        depends on !DOG_DETECT_MODEL_IN_SDCARD
        default n

    choice
        prompt "default model"
        default ESPDET_PICO_224_224_DOG
        help
            default dog_detect model
        config ESPDET_PICO_224_224_DOG
            bool "espdet_pico_224_224_dog"
            depends on DOG_DETECT_MODEL_IN_SDCARD || FLASH_ESPDET_PICO_224_224_DOG
        config ESPDET_PICO_416_416_DOG
            bool "espdet_pico_416_416_dog"
            depends on DOG_DETECT_MODEL_IN_SDCARD || FLASH_ESPDET_PICO_416_416_DOG
    endchoice

    config DEFAULT_DOG_DETECT_MODEL
        int
        default 0 if ESPDET_PICO_224_224_DOG
        default 1 if ESPDET_PICO_416_416_DOG

    choice
        prompt "model location"
        default DOG_DETECT_MODEL_IN_FLASH_RODATA
        help
            dog_detect model location
        config DOG_DETECT_MODEL_IN_FLASH_RODATA
            bool "flash_rodata"
        config DOG_DETECT_MODEL_IN_FLASH_PARTITION
            bool "flash_partition"
        config DOG_DETECT_MODEL_IN_SDCARD
            bool "sdcard"
    endchoice

    config DOG_DETECT_MODEL_LOCATION
        int
        default 0 if DOG_DETECT_MODEL_IN_FLASH_RODATA
        default 1 if DOG_DETECT_MODEL_IN_FLASH_PARTITION
        default 2 if DOG_DETECT_MODEL_IN_SDCARD

    config DOG_DETECT_MODEL_SDCARD_DIR
        string "dog_detect model sdcard dir"
        default "models/s3" if IDF_TARGET_ESP32S3
        default "models/p4" if IDF_TARGET_ESP32P4
        depends on DOG_DETECT_MODEL_IN_SDCARD
        help
            Directory of models relative to sdcard mount point.
endmenu
```
