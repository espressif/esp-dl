## models/hand_detect/Kconfig
```kconfig
menu "models: hand_detect"
    config FLASH_ESPDET_PICO_224_224_HAND
        bool "flash espdet_pico_224_224_hand"
        depends on !HAND_DETECT_MODEL_IN_SDCARD
        default y

    choice
        prompt "default model"
        default ESPDET_PICO_224_224_HAND
        help
            default hand_detect model
        config ESPDET_PICO_224_224_HAND
            bool "espdet_pico_224_224_hand"
            depends on HAND_DETECT_MODEL_IN_SDCARD || FLASH_ESPDET_PICO_224_224_HAND
    endchoice

    config DEFAULT_HAND_DETECT_MODEL
        int
        default 0 if ESPDET_PICO_224_224_HAND

    choice
        prompt "model location"
        default HAND_DETECT_MODEL_IN_FLASH_RODATA
        help
            hand_detect model location
        config HAND_DETECT_MODEL_IN_FLASH_RODATA
            bool "flash_rodata"
        config HAND_DETECT_MODEL_IN_FLASH_PARTITION
            bool "flash_partition"
        config HAND_DETECT_MODEL_IN_SDCARD
            bool "sdcard"
    endchoice

    config HAND_DETECT_MODEL_LOCATION
        int
        default 0 if HAND_DETECT_MODEL_IN_FLASH_RODATA
        default 1 if HAND_DETECT_MODEL_IN_FLASH_PARTITION
        default 2 if HAND_DETECT_MODEL_IN_SDCARD

    config HAND_DETECT_MODEL_SDCARD_DIR
        string "hand_detect model sdcard dir"
        default "models/s3" if IDF_TARGET_ESP32S3
        default "models/p4" if IDF_TARGET_ESP32P4
        depends on HAND_DETECT_MODEL_IN_SDCARD
        help
            Directory of models relative to sdcard mount point.
endmenu
```

## models/hand_gesture_recognition/Kconfig
```kconfig
menu "models: hand_gesture_cls"
    config FLASH_HAND_GESTURE_CLS_MOBILENETV2_0_5_S8_V1
        bool "flash hand_gesture_cls_mobilenetv2_0_5_s8_v1"
        depends on !HAND_GESTURE_CLS_MODEL_IN_SDCARD
        default y

    choice
        prompt "default model"
        default HAND_GESTURE_CLS_MOBILENETV2_0_5_S8_V1
        help
            default hand_gesture_cls model
        config HAND_GESTURE_CLS_MOBILENETV2_0_5_S8_V1
            bool "hand_gesture_cls_mobilenetv2_0_5_s8_v1"
            depends on HAND_GESTURE_CLS_MODEL_IN_SDCARD || FLASH_HAND_GESTURE_CLS_MOBILENETV2_0_5_S8_V1

    endchoice

    config DEFAULT_HAND_GESTURE_CLS_MODEL
        int
        default 0 if HAND_GESTURE_CLS_MOBILENETV2_0_5_S8_V1

    choice
        prompt "model location"
        default HAND_GESTURE_CLS_MODEL_IN_FLASH_RODATA
        help
            hand_gesture_cls model location
        config HAND_GESTURE_CLS_MODEL_IN_FLASH_RODATA
            bool "flash_rodata"
        config HAND_GESTURE_CLS_MODEL_IN_FLASH_PARTITION
            bool "flash_partition"
        config HAND_GESTURE_CLS_MODEL_IN_SDCARD
            bool "sdcard"
    endchoice

    config HAND_GESTURE_CLS_MODEL_LOCATION
        int
        default 0 if HAND_GESTURE_CLS_MODEL_IN_FLASH_RODATA
        default 1 if HAND_GESTURE_CLS_MODEL_IN_FLASH_PARTITION
        default 2 if HAND_GESTURE_CLS_MODEL_IN_SDCARD

    config HAND_GESTURE_CLS_MODEL_SDCARD_DIR
        string "hand_gesture_cls model sdcard dir"
        default "models/s3" if IDF_TARGET_ESP32S3
        default "models/p4" if IDF_TARGET_ESP32P4
        depends on HAND_GESTURE_CLS_MODEL_IN_SDCARD
        help
            Directory of models relative to sdcard mount point.
endmenu
```

## models/human_face_detect/Kconfig
```kconfig
menu "models: human_face_detect"
    config FLASH_HUMAN_FACE_DETECT_MSRMNP_S8_V1
        bool "flash human_face_detect_msrmnp_s8_v1"
        depends on !HUMAN_FACE_DETECT_MODEL_IN_SDCARD
        default y
    config FLASH_ESPDET_PICO_224_224_FACE
        bool "flash espdet_pico_224_224_face"
        depends on !HUMAN_FACE_DETECT_MODEL_IN_SDCARD
        default n
    config FLASH_ESPDET_PICO_416_416_FACE
        bool "flash espdet_pico_416_416_face"
        depends on !HUMAN_FACE_DETECT_MODEL_IN_SDCARD
        default n

    choice
        prompt "default model"
        default HUMAN_FACE_DETECT_MSRMNP_S8_V1
        help
            default human_face_detect model
        config HUMAN_FACE_DETECT_MSRMNP_S8_V1
            bool "human_face_detect_msrmnp_s8_v1"
            depends on HUMAN_FACE_DETECT_MODEL_IN_SDCARD || FLASH_HUMAN_FACE_DETECT_MSRMNP_S8_V1
        config ESPDET_PICO_224_224_FACE
            bool "espdet_pico_224_224_face"
            depends on HUMAN_FACE_DETECT_MODEL_IN_SDCARD || FLASH_ESPDET_PICO_224_224_FACE
        config ESPDET_PICO_416_416_FACE
            bool "espdet_pico_416_416_face"
            depends on HUMAN_FACE_DETECT_MODEL_IN_SDCARD || FLASH_ESPDET_PICO_416_416_FACE
    endchoice

    config DEFAULT_HUMAN_FACE_DETECT_MODEL
        int
        default 0 if HUMAN_FACE_DETECT_MSRMNP_S8_V1
        default 1 if ESPDET_PICO_224_224_FACE
        default 2 if ESPDET_PICO_416_416_FACE


    choice
        prompt "model location"
        default HUMAN_FACE_DETECT_MODEL_IN_FLASH_RODATA
        help
            human_face_detect model location
        config HUMAN_FACE_DETECT_MODEL_IN_FLASH_RODATA
            bool "flash_rodata"
        config HUMAN_FACE_DETECT_MODEL_IN_FLASH_PARTITION
            bool "flash_partition"
        config HUMAN_FACE_DETECT_MODEL_IN_SDCARD
            bool "sdcard"
    endchoice

    config HUMAN_FACE_DETECT_MODEL_LOCATION
        int
        default 0 if HUMAN_FACE_DETECT_MODEL_IN_FLASH_RODATA
        default 1 if HUMAN_FACE_DETECT_MODEL_IN_FLASH_PARTITION
        default 2 if HUMAN_FACE_DETECT_MODEL_IN_SDCARD

    config HUMAN_FACE_DETECT_MODEL_SDCARD_DIR
        string "human_face_detect model sdcard dir"
        default "models/s3" if IDF_TARGET_ESP32S3
        default "models/p4" if IDF_TARGET_ESP32P4
        depends on HUMAN_FACE_DETECT_MODEL_IN_SDCARD
        help
            Directory of models relative to sdcard mount point.

endmenu
```

## models/human_face_recognition/Kconfig
```kconfig
menu "models: human_face_feat"
    config FLASH_HUMAN_FACE_FEAT_MFN_S8_V1
        bool "flash human_face_feat_mfn_s8_v1"
        depends on !HUMAN_FACE_FEAT_MODEL_IN_SDCARD
        default y
    config FLASH_HUMAN_FACE_FEAT_MBF_S8_V1
        bool "flash human_face_feat_mbf_s8_v1"
        depends on !HUMAN_FACE_FEAT_MODEL_IN_SDCARD
        default n

    choice
        prompt "default model"
        default HUMAN_FACE_FEAT_MFN_S8_V1
        help
            default human_face_feat model
        config HUMAN_FACE_FEAT_MFN_S8_V1
            bool "human_face_feat_mfn_s8_v1"
            depends on HUMAN_FACE_FEAT_MODEL_IN_SDCARD || FLASH_HUMAN_FACE_FEAT_MFN_S8_V1
        config HUMAN_FACE_FEAT_MBF_S8_V1
            bool "human_face_feat_mbf_s8_v1"
            depends on HUMAN_FACE_FEAT_MODEL_IN_SDCARD || FLASH_HUMAN_FACE_FEAT_MBF_S8_V1
    endchoice

    config DEFAULT_HUMAN_FACE_FEAT_MODEL
        int
        default 0 if HUMAN_FACE_FEAT_MFN_S8_V1
        default 1 if HUMAN_FACE_FEAT_MBF_S8_V1

    choice
        prompt "model location"
        default HUMAN_FACE_FEAT_MODEL_IN_FLASH_RODATA
        help
            human_face_feat model location
        config HUMAN_FACE_FEAT_MODEL_IN_FLASH_RODATA
            bool "flash_rodata"
        config HUMAN_FACE_FEAT_MODEL_IN_FLASH_PARTITION
            bool "flash_partition"
        config HUMAN_FACE_FEAT_MODEL_IN_SDCARD
            bool "sdcard"
    endchoice

    config HUMAN_FACE_FEAT_MODEL_LOCATION
        int
        default 0 if HUMAN_FACE_FEAT_MODEL_IN_FLASH_RODATA
        default 1 if HUMAN_FACE_FEAT_MODEL_IN_FLASH_PARTITION
        default 2 if HUMAN_FACE_FEAT_MODEL_IN_SDCARD

    config HUMAN_FACE_FEAT_MODEL_SDCARD_DIR
        string "human_face_feat model sdcard dir"
        default "models/s3" if IDF_TARGET_ESP32S3
        default "models/p4" if IDF_TARGET_ESP32P4
        depends on HUMAN_FACE_FEAT_MODEL_IN_SDCARD
        help
            Directory of models relative to sdcard mount point.
endmenu
```

## models/imagenet_cls/Kconfig
```kconfig
menu "models: imagenet_cls"
    config FLASH_IMAGENET_CLS_MOBILENETV2_S8_V1
        bool "flash imagenet_cls_mobilenetv2_s8_v1"
        depends on !IMAGENET_CLS_MODEL_IN_SDCARD
        default y

    choice
        prompt "default model"
        default IMAGENET_CLS_MOBILENETV2_S8_V1
        help
            default imagenet_cls model
        config IMAGENET_CLS_MOBILENETV2_S8_V1
            bool "imagenet_cls_mobilenetv2_s8_v1"
            depends on IMAGENET_CLS_MODEL_IN_SDCARD || FLASH_IMAGENET_CLS_MOBILENETV2_S8_V1
    endchoice

    config DEFAULT_IMAGENET_CLS_MODEL
        int
        default 0 if IMAGENET_CLS_MOBILENETV2_S8_V1

    choice
        prompt "model location"
        default IMAGENET_CLS_MODEL_IN_FLASH_RODATA
        help
            imagenet_cls model location
        config IMAGENET_CLS_MODEL_IN_FLASH_RODATA
            bool "flash_rodata"
        config IMAGENET_CLS_MODEL_IN_FLASH_PARTITION
            bool "flash_partition"
        config IMAGENET_CLS_MODEL_IN_SDCARD
            bool "sdcard"
    endchoice

    config IMAGENET_CLS_MODEL_LOCATION
        int
        default 0 if IMAGENET_CLS_MODEL_IN_FLASH_RODATA
        default 1 if IMAGENET_CLS_MODEL_IN_FLASH_PARTITION
        default 2 if IMAGENET_CLS_MODEL_IN_SDCARD

    config IMAGENET_CLS_MODEL_SDCARD_DIR
        string "imagenet_cls model sdcard dir"
        default "models/s3" if IDF_TARGET_ESP32S3
        default "models/p4" if IDF_TARGET_ESP32P4
        depends on IMAGENET_CLS_MODEL_IN_SDCARD
        help
            Directory of models relative to sdcard mount point.
endmenu
```

## models/pedestrian_detect/Kconfig
```kconfig
menu "models: pedestrian_detect"
    config FLASH_PEDESTRIAN_DETECT_PICO_S8_V1
        bool "flash pedestrian_detect_pico_s8_v1"
        depends on !PEDESTRIAN_DETECT_MODEL_IN_SDCARD
        default y

    choice
        prompt "default model"
        default PEDESTRIAN_DETECT_PICO_S8_V1
        help
            default pedestrian_detect model
        config PEDESTRIAN_DETECT_PICO_S8_V1
            bool "pedestrian_detect_pico_s8_v1"
            depends on PEDESTRIAN_DETECT_MODEL_IN_SDCARD || FLASH_PEDESTRIAN_DETECT_PICO_S8_V1
    endchoice

    config DEFAULT_PEDESTRIAN_DETECT_MODEL
        int
        default 0 if PEDESTRIAN_DETECT_PICO_S8_V1

    choice
        prompt "model location"
        default PEDESTRIAN_DETECT_MODEL_IN_FLASH_RODATA
        help
            pedestrian_detect model location
        config PEDESTRIAN_DETECT_MODEL_IN_FLASH_RODATA
            bool "flash_rodata"
        config PEDESTRIAN_DETECT_MODEL_IN_FLASH_PARTITION
            bool "flash_partition"
        config PEDESTRIAN_DETECT_MODEL_IN_SDCARD
            bool "sdcard"
    endchoice

    config PEDESTRIAN_DETECT_MODEL_LOCATION
        int
        default 0 if PEDESTRIAN_DETECT_MODEL_IN_FLASH_RODATA
        default 1 if PEDESTRIAN_DETECT_MODEL_IN_FLASH_PARTITION
        default 2 if PEDESTRIAN_DETECT_MODEL_IN_SDCARD

    config PEDESTRIAN_DETECT_MODEL_SDCARD_DIR
        string "pedestrian_detect model sdcard dir"
        default "models/s3" if IDF_TARGET_ESP32S3
        default "models/p4" if IDF_TARGET_ESP32P4
        depends on PEDESTRIAN_DETECT_MODEL_IN_SDCARD
        help
            Directory of models relative to sdcard mount point.
endmenu
```

## models/person_reid/Kconfig
```kconfig
menu "models: person_reid_feat"
    config FLASH_PERSON_REID_FEAT_OSN_S8_V1
        bool "flash person_reid_feat_osn_s8_v1"
        depends on !PERSON_REID_FEAT_MODEL_IN_SDCARD
        default y

    choice
        prompt "default model"
        default PERSON_REID_FEAT_OSN_S8_V1
        help
            default person_reid_feat model
        config PERSON_REID_FEAT_OSN_S8_V1
            bool "person_reid_feat_osn_s8_v1"
            depends on PERSON_REID_FEAT_MODEL_IN_SDCARD || FLASH_PERSON_REID_FEAT_OSN_S8_V1
    endchoice

    config DEFAULT_PERSON_REID_FEAT_MODEL
        int
        default 0 if PERSON_REID_FEAT_OSN_S8_V1

    choice
        prompt "model location"
        default PERSON_REID_FEAT_MODEL_IN_FLASH_RODATA
        help
            person_reid_feat model location
        config PERSON_REID_FEAT_MODEL_IN_FLASH_RODATA
            bool "flash_rodata"
        config PERSON_REID_FEAT_MODEL_IN_FLASH_PARTITION
            bool "flash_partition"
        config PERSON_REID_FEAT_MODEL_IN_SDCARD
            bool "sdcard"
    endchoice

    config PERSON_REID_FEAT_MODEL_LOCATION
        int
        default 0 if PERSON_REID_FEAT_MODEL_IN_FLASH_RODATA
        default 1 if PERSON_REID_FEAT_MODEL_IN_FLASH_PARTITION
        default 2 if PERSON_REID_FEAT_MODEL_IN_SDCARD

    config PERSON_REID_FEAT_MODEL_SDCARD_DIR
        string "person_reid_feat model sdcard dir"
        default "models/s3" if IDF_TARGET_ESP32S3
        default "models/p4" if IDF_TARGET_ESP32P4
        depends on PERSON_REID_FEAT_MODEL_IN_SDCARD
        help
            Directory of models relative to sdcard mount point.
endmenu
```

## models/speaker_verification/Kconfig
```kconfig
menu "models: speaker_verification"
    config FLASH_SPEAKER_VERIFICATION
        bool "flash speaker_verification_model"
        depends on !SPEAKER_VERIFICATION_MODEL_IN_SDCARD
        default y

    choice
        prompt "default model"
        default SPEAKER_VERIFICATION_MODEL_IN_FLASH
        help
            default speaker_verification model
        config SPEAKER_VERIFICATION_MODEL_IN_FLASH
            bool "speaker_verification_flash"
            depends on SPEAKER_VERIFICATION_MODEL_IN_SDCARD || FLASH_SPEAKER_VERIFICATION
    endchoice

    config DEFAULT_SPEAKER_VERIFICATION_MODEL
        int
        default 0 if SPEAKER_VERIFICATION_MODEL

    choice
        prompt "model location"
        default SPEAKER_VERIFICATION_MODEL_IN_FLASH_RODATA
        help
            speaker_verification model location
        config SPEAKER_VERIFICATION_MODEL_IN_FLASH_RODATA
            bool "flash_rodata"
        config SPEAKER_VERIFICATION_MODEL_IN_FLASH_PARTITION
            bool "flash_partition"
        config SPEAKER_VERIFICATION_MODEL_IN_SDCARD
            bool "sdcard"
    endchoice

    config SPEAKER_VERIFICATION_MODEL_LOCATION
        int
        default 0 if SPEAKER_VERIFICATION_MODEL_IN_FLASH_RODATA
        default 1 if SPEAKER_VERIFICATION_MODEL_IN_FLASH_PARTITION
        default 2 if SPEAKER_VERIFICATION_MODEL_IN_SDCARD

    config SPEAKER_VERIFICATION_MODEL_SDCARD_DIR
        string "speaker_verification model sdcard dir"
        default "models/p4" if IDF_TARGET_ESP32P4
        depends on SPEAKER_VERIFICATION_MODEL_IN_SDCARD
        help
            Directory of models relative to sdcard mount point.
endmenu
```

## test_apps/autoquant_latency/main/Kconfig.projbuild
```kconfig
menu "AutoQuant latency model"

config MODEL_FILE_PATH
	string "Path to .espdl file or directory for pack_espdl_models"
	default ""

endmenu
```

## test_apps/dl_pie_func/sdkconfig.defaults
```kconfig
CONFIG_PARTITION_TABLE_OFFSET=0x9000

# Diagnostic aid for the "Guru Meditation Error (LoadProhibited)" crash seen in
# reduce_sum/reduce_mean speed tests: the crash happens inside Unity's own
# UnityPrint()/CurrentDetail2 bookkeeping, which this project never writes to,
# implying some earlier buffer write is overrunning into adjacent heap memory
# and only surfacing much later. Comprehensive heap poisoning makes
# heap_caps_malloc/free validate guard bytes on every call, so an overrun is
# caught immediately at the offending allocation instead of crashing several
# tests later with a confusing, unrelated-looking backtrace.
CONFIG_HEAP_POISONING_COMPREHENSIVE=y
CONFIG_ESP_MAIN_TASK_STACK_SIZE=8000
```
