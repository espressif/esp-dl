## tools/dl_fft/Kconfig
```kconfig
menu "DL_FFT Library"


choice DL_FFT_KISS_FFT_SUPPORTED
    prompt "Whether to support kiss fft"
    default DL_FFT_WITHOUT_KISS_FFT

    config DL_FFT_WITHOUT_KISS_FFT
        bool "do not support kiss fft"

    config DL_FFT_WITH_KISS_FFT
        bool "support kiss fft"
endchoice

endmenu
```

## tools/tvm/template_project_for_model/sdkconfig.defaults
```kconfig
CONFIG_ESPTOOLPY_FLASHSIZE_4MB=y

CONFIG_ESPTOOLPY_FLASHFREQ_80M=y
CONFIG_ESPTOOLPY_FLASHMODE_QIO=y

CONFIG_SPIRAM_SPEED_80M=y
CONFIG_SPIRAM_USE_CAPS_ALLOC=y

CONFIG_PARTITION_TABLE_CUSTOM=y
CONFIG_PARTITION_TABLE_CUSTOM_FILENAME="partitions.csv"

CONFIG_UNITY_ENABLE_COLOR=y
CONFIG_UNITY_ENABLE_FIXTURE=y
CONFIG_UNITY_ENABLE_BACKTRACE_ON_FAIL=y

CONFIG_ESP_INT_WDT=n
CONFIG_ESP_TASK_WDT=n
CONFIG_COMPILER_CXX_EXCEPTIONS=y
```
